## configs/chippro_defconfig
```kconfig
CONFIG_ARM=y
CONFIG_ARCH_SUNXI=y
CONFIG_MACH_SUN5I=y
CONFIG_DRAM_TPR3=0x0
CONFIG_DRAM_DQS_GATING_DELAY=0x0
CONFIG_DRAM_TIMINGS_DDR3_800E_1066G_1333J=y
# CONFIG_MMC is not set
CONFIG_USB0_VBUS_PIN="PB10"
CONFIG_I2C1_ENABLE=y
CONFIG_AXP_GPIO=y
# CONFIG_VIDEO is not set
CONFIG_DEFAULT_DEVICE_TREE="sun5i-r8-chip"
# CONFIG_SYS_MALLOC_CLEAR_ON_INIT is not set
CONFIG_SPL=y
CONFIG_SYS_EXTRA_OPTIONS="CONS_INDEX=2,ENV_IS_IN_NAND"
# CONFIG_CMD_CONSOLE is not set
# CONFIG_CMD_IMLS is not set
# CONFIG_CMD_FPGA is not set
CONFIG_CMD_GPIO=y
# CONFIG_CMD_NFS is not set
CONFIG_BOOTSTAGE_USER_COUNT=0x20
CONFIG_BOOTSTAGE_STASH_ADDR=0x0
CONFIG_BOOTSTAGE_STASH_SIZE=0x4096
CONFIG_NAND_SUNXI=y
CONFIG_SPL_NAND_U_BOOT_OFFS=0x800000
CONFIG_AXP_ALDO3_VOLT=3300
CONFIG_AXP_ALDO4_VOLT=3300
CONFIG_USB_MUSB_GADGET=y
CONFIG_VIDEO_CHRONTEL_CH7033_I2C_BUS=1
CONFIG_CC_OPTIMIZE_LIBS_FOR_SPEED=y
```

## drivers/eeprom/Kconfig
```kconfig
#
# EEPROM subsystem configuration
#

menu "EEPROM support"

config EEPROM
	bool "Enable EEPROM support"
	depends on DM
	help
	  Support for the EEPROMs

if EEPROM

endif

endmenu
```

## drivers/w1/Kconfig
```kconfig
#
# W1 subsystem configuration
#

menu "1-Wire support"

config W1
	bool "Enable 1-Wire controllers support"
	depends on DM
	help
	  Support for the Dallas 1-Wire bus.

if W1

endif

endmenu
```
